## components/msgpack-c/zephyr/Kconfig
```kconfig
# @file      Kconfig
# @brief     msgpack-c module Kconfig file
#
# Copyright joelguittet and mender-mcu-client contributors
#
# Licensed under the Apache License, Version 2.0 (the "License");
# you may not use this file except in compliance with the License.
# You may obtain a copy of the License at
#
#     http://www.apache.org/licenses/LICENSE-2.0
#
# Unless required by applicable law or agreed to in writing, software
# distributed under the License is distributed on an "AS IS" BASIS,
# WITHOUT WARRANTIES OR CONDITIONS OF ANY KIND, either express or implied.
# See the License for the specific language governing permissions and
# limitations under the License.

menuconfig MSGPACK_C
    bool "MessagePack implementation for C and C++" 
    help
        MessagePack is an efficient binary serialization format, which lets you
        exchange data among multiple languages like JSON, except that it's faster
        and smaller.
```
